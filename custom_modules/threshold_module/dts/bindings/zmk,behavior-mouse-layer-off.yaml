## custom_modules/threshold_module/dts/bindings/zmk,behavior-mouse-layer-off.yaml
```yaml
description: Deactivate the configured temporary mouse layer and reset threshold processor state

compatible: "zmk,behavior-mouse-layer-off"

include: zero_param.yaml

properties:
  layer:
    type: int
    required: true
    description: Layer index to deactivate
```

## custom_modules/threshold_module/dts/bindings/zmk,input-processor-threshold-layer.yaml
```yaml
description: |
  ZMK input processor that observes relative X/Y movement and activates a
  temporary layer after both a movement threshold and activation delay are met.
  An incomplete movement sequence resets after movement-gap-ms of inactivity.

compatible: "zmk,input-processor-threshold-layer"

properties:
  "#input-processor-cells":
    type: int
    required: true
    const: 2

  threshold:
    type: int
    default: 128
    description: Sum of absolute relative X/Y counts required for activation

  movement-gap-ms:
    type: int
    default: 100
    description: Inactivity gap that resets pending movement and delay state

  activation-delay-ms:
    type: int
    default: 0
    description: Continuous movement-sequence duration required before activation

  track-remainders:
    type: boolean
    description: Compatibility flag accepted for existing keymaps; this observer processor does not modify pointer remainders

input-processor-cells:
  - param1
  - param2
```

## custom_modules/threshold_module/zephyr/Kconfig
```kconfig
menuconfig ZMK_INPUT_PROCESSOR_THRESHOLD_LAYER
    bool "Threshold temporary-layer input processor"
    default y
    help
      Activates a temporary layer after configured movement, gap, and delay
      conditions are met without modifying pointer events.
```

## modules/threshold_module/dts/bindings/input/zmk,input-processor-threshold-layer.yaml
```yaml
description: ZMK pointer movement threshold temporary-layer input processor

compatible: "zmk,input-processor-threshold-layer"

properties:
  threshold:
    type: int
    required: true
    description: Cumulative pointer movement required to activate the layer

  reset-timeout-ms:
    type: int
    default: 200
    description: Inactivity time before accumulated movement is reset

  track-remainders:
    type: boolean
    description: Whether movement below the threshold is accumulated

input-processor-cells:
  - layer
  - timeout-ms
```

## modules/threshold_module/dts/bindings/zmk,input-processor-threshold-layer.yaml
```yaml
description: |
  ZMK input processor that activates a temporary layer only after
  cumulative relative pointer movement reaches a threshold.

compatible: "zmk,input-processor-threshold-layer"

properties:
  "#input-processor-cells":
    type: int
    required: true
    const: 2

  threshold:
    type: int
    default: 16
    description: Cumulative absolute X/Y movement required to activate the layer

  reset-timeout-ms:
    type: int
    default: 200
    description: Inactivity duration before pre-threshold accumulated movement resets

input-processor-cells:
  - param1
  - param2
```

## modules/threshold_module/zephyr/Kconfig
```kconfig
menuconfig ZMK_INPUT_PROCESSOR_THRESHOLD_LAYER
    bool "Movement-threshold temporary layer input processor"
    default y
    depends on ZMK_POINTING
    help
      Enables an input processor that accumulates relative X/Y movement and
      activates a temporary layer only after a configured threshold is reached.
```

## threshold_module/dts/bindings/input/zmk,input-processor-threshold-layer.yaml
```yaml
description: ZMK pointer movement threshold temporary-layer input processor
compatible: "zmk,input-processor-threshold-layer"
include: base.yaml
properties:
  "#input-processor-cells":
    type: int
    const: 3
  require-prior-idle-ms:
    type: int
    default: 0
  excluded-positions:
    type: array
input-processor-cells:
  - layer
  - timeout-ms
  - threshold
```
